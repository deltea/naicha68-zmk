## config/dts/bindings/gpio/nxp,pca9555.yaml
```yaml
description: NXP PCA9555 I2C GPIO Expander

compatible: "nxp,pca9555"

include: gpio-controller.yaml

properties:
  reg:
    required: true
    description: I2C address of the device (typically 0x20-0x27)

  gpio-controller:
    type: boolean
    required: true
    description: Convey's this node is a GPIO controller

  "#gpio-cells":
    const: 2

  ngpios:
    type: int
    default: 16
    description: Number of GPIO pins on this expander
```

## config/west.yml
```yaml
manifest:
  defaults:
    revision: v0.3
  remotes:
    - name: zmkfirmware
      url-base: https://github.com/zmkfirmware
    - name: pca9555_bindings_base
      url-base: https://github.com/deltea
    # Additional modules containing boards/shields/custom code can be listed here as well
    # See https://docs.zephyrproject.org/3.2.0/develop/west/manifest.html#projects
  projects:
    - name: zmk
      remote: zmkfirmware
      import: app/west.yml
    - name: pca9555-bindings-module
      remote: pca9555_bindings_base
      revision: main
      import: west.yml
  self:
    path: config
```
